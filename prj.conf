## CMakeLists.txt
```
cmake_minimum_required(VERSION 3.13.1)

set(BOARD_ROOT ${CMAKE_SOURCE_DIR})

include($ENV{ZEPHYR_BASE}/cmake/app/boilerplate.cmake NO_POLICY_SCOPE)
project(Zeta)

# Generate version file
set(CMAKE_EXPORT_COMPILE_COMMANDS ON)

# Add header directories
list(APPEND HEADERS
    "${PROJECT_BINARY_DIR}/include/generated"
    "${PROJECT_BINARY_DIR}/zephyr/include/generated"
    "${PROJECT_SOURCE_DIR}/include"
    )

# Add source files
list(APPEND SOURCES
    "${PROJECT_BINARY_DIR}/zephyr/src/generated/zeta.c"
    "${PROJECT_BINARY_DIR}/zephyr/src/generated/zeta_threads.c"
    )

if(CONFIG_ZTEST)
  message("Ztest enabled, adding test_main.c and user source files to source files list.")
  list(APPEND HEADERS
    "${PROJECT_SOURCE_DIR}/test/include"
    )
  list(APPEND SOURCES
    "${PROJECT_SOURCE_DIR}/test/src/test_main.c"
    "${PROJECT_SOURCE_DIR}/test/src/test_functions.c"
    )
  # Generating properties macro create
  add_custom_target(
    generateFiles ALL
    COMMAND python3 ${PROJECT_SOURCE_DIR}/zeta_generate.py -f ../test/zeta_test.yaml 
    BYPRODUCTS "${PROJECT_BINARY_DIR}/zephyr/src/generated/zeta.c" "${PROJECT_BINARY_DIR}/zephyr/src/generated/zeta_threads.c"
    COMMENT "Generating files from templates"
    )
  add_dependencies(app generateFiles)
else()
  message("Ztest disabled, adding main.c and user source files to source files list.")
  list(APPEND SOURCES
    "${PROJECT_SOURCE_DIR}/src/main.c"
    )
  # Generating properties macro create
  add_custom_target(
    generateFiles ALL
    COMMAND python3 ${PROJECT_SOURCE_DIR}/zeta_generate.py -f ../zeta.yaml 
    BYPRODUCTS "${PROJECT_BINARY_DIR}/zephyr/src/generated/zeta.c" "${PROJECT_BINARY_DIR}/zephyr/src/generated/zeta_threads.c"
    COMMENT "Generating files from templates"
    )
  add_dependencies(app generateFiles)
  
endif()  

target_include_directories(app PRIVATE ${HEADERS})
target_sources(app PRIVATE ${SOURCES})

#####################################
# Setting tests                     #
#####################################

# enable_testing()
# # list(APPEND TEST_HEADERS
# #     "build/include/generated"
# #     "build/zephyr/include/generated"
# #     "include"
# #     )

# add_executable(testandoCtest test/src/main_ctest.c)
# target_include_directories(testandoCtest PRIVATE ${HEADERS})
# add_test(TestandoCtest testandoCtest)
```

## prj.conf
```kconfig
# Flash and NVS
CONFIG_FLASH=y
CONFIG_FLASH_PAGE_LAYOUT=y
CONFIG_NVS=y

# LOG
CONFIG_LOG=y
CONFIG_LOG_MAX_LEVEL=4
CONFIG_LOG_DEFAULT_LEVEL=3
CONFIG_TEST_LOGGING_DEFAULTS=n

# Test
CONFIG_ZTEST=y
```

## src/main.c
```c
/*
 * Copyright (c) 2012-2014 Wind River Systems, Inc.
 *
 * SPDX-License-Identifier: Apache-2.0
 */

#include <zephyr.h>

#include "autoconf.h"
#include "zeta.h"
#include "zeta_threads.h"

K_SEM_DEFINE(zeta_core_pend_evt, 0, 1);
K_SEM_DEFINE(zeta_app_pend_evt, 0, 1);

zeta_channel_e zeta_core_evt_id;
zeta_channel_e zeta_app_evt_id;

int zeta_validator_different_of_zero(u8_t *data, size_t size)
{
    return 1;
}

void HAL_task(void)
{
    u8_t data = 1;
    while (1) {
        zeta_channel_set(ZETA_SENSOR_VAL_CHANNEL, (u8_t *) &data, sizeof(data));
        k_sleep(K_SECONDS(3));
        data = (data + 1 <= 15) ? data + 1 : 1;
    }
}

void CORE_task(void)
{
    u8_t data  = 0;
    u8_t power = 2;

    while (1) {
        u16_t result = 1;
        k_sem_take(&zeta_core_pend_evt, K_FOREVER);
        switch (zeta_core_evt_id) {
        case ZETA_SENSOR_VAL_CHANNEL:
            zeta_channel_get(zeta_core_evt_id, (u8_t *) &data, sizeof(data));
            printk("[CORE_service_callback] Getting data value %02X\n", data);
            for (u8_t i = 1; i <= data; ++i) {
                result = result * power;
            }
            zeta_channel_set(ZETA_POWER_VAL_CHANNEL, (u8_t *) &result, sizeof(result));
            break;
        default:
            printk("[CORE_service_callback] receiving an unexpected id channel\n");
            break;
        }
    }
}

void APP_task(void)
{
    u8_t fv[4] = {0};
    printk("Hello APP task!\n");
    zeta_channel_get(ZETA_FIRMWARE_VERSION_CHANNEL, fv, sizeof(fv));
    printk("Firmware version 0x%02X%02X%02X%02X\n", fv[0], fv[1], fv[2], fv[3]);
    u16_t data = 0;
    while (1) {
        k_sem_take(&zeta_app_pend_evt, K_FOREVER);
        switch (zeta_app_evt_id) {
        case ZETA_POWER_VAL_CHANNEL:
            zeta_channel_get(zeta_app_evt_id, (u8_t *) &data, sizeof(data));
            printk("[APP_service_callback] Power val is: %04X\n", data);
            break;
        default:
            printk("[APP_service_callback] receiving an unexpected id channel\n");
        }
    }
}

void CORE_service_callback(zeta_channel_e id)
{
    zeta_core_evt_id = id;
    k_sem_give(&zeta_core_pend_evt);
}

void HAL_service_callback(zeta_channel_e id)
{
}

void APP_service_callback(zeta_channel_e id)
{
    zeta_app_evt_id = id;
    k_sem_give(&zeta_app_pend_evt);
}

void main(void)
{
    printk("******** ZETA test! *******\n");
}
```

## include/pdb.h
```c
/*!
 * @file
 * @brief This is the abstraction information relative to NB hardware
 *
 */

#ifndef PDB_H_
#define PDB_H_

#include <stddef.h>
#include <zephyr.h>
#include <zephyr/types.h>

#define PDB_THREAD_SIZE 1024
#define PDB_THREAD_PRIORITY -2


#define PDB_VALUE_REF(x) (u8_t *) (&x), sizeof(x)
#define PDB_ASSERT_VAL(_p, _e, _err, ...) \
    if (_p != _e) {                       \
        printk(__VA_ARGS__);              \
        return _err;                      \
    }

#define PDB_ASSERT(_p, _err, ...) \
    if (_p) {                     \
        printk(__VA_ARGS__);      \
        return _err;              \
    }


/* Defining PDB_PROPERTY_CREATE for enum generating */
/* #define PDB_PROPERTY_CREATE(_name, _bytes, _validate, _get, _set, _in_flash, _observers, _id,
 * ...) \ */
/*     PDB_##_name##_PROPERTY, */

typedef enum { PDB_PROPERTY_COUNT } pdb_property_e;

typedef struct {
    k_tid_t source_thread;
    pdb_property_e id;
} pdb_event_t;

typedef void (*pdb_callback_f)(pdb_property_e id);

struct pdb_property {
    const char *name;
    u8_t *data;
    int (*validate)(u8_t *data, size_t size);
    int (*get)(pdb_property_e id, u8_t *property_value, size_t size);
    int (*pre_set)(void);
    int (*set)(pdb_property_e id, u8_t *property_value, size_t size);
    int (*pos_set)(void);
    u8_t size;
    u8_t in_flash;
    u8_t changed;
    u8_t observers;
    struct k_sem *sem;
    pdb_callback_f *cbs;
    pdb_property_e id;
};
typedef struct pdb_property pdb_property_t;

/**
 * Returns the property size.
 *
 * @param id property ID.
 * @param error variable to handle possible errors.
 *
 * @return property size.
 */
size_t pdb_property_size(pdb_property_e id, int *error);

/* TODO: Add doxygen comments about pdb_property_name */
const char *pdb_property_name(pdb_property_e id);

/**
 * Gets the property value.
 *
 * @param id property ID.
 * @param property_value handle the property value.
 * @param size property value size.
 *
 * @return error code.
 */
int pdb_property_get(pdb_property_e id, u8_t *property_value, size_t size);

/**
 * Gets the property value private.
 *
 * @param id property ID.
 * @param property_value handle the property value.
 * @param size property value size.
 *
 * @return error code.
 */
int pdb_property_get_private(pdb_property_e id, u8_t *property_value, size_t size);

/**
 * Sets the property value.
 *
 * @param id property ID.
 * @param property_value property value that must to be setted.
 * @param size property value size.
 *
 * @return error code.
 */
int pdb_property_set(pdb_property_e id, u8_t *property_value, size_t size);


/**
 * Sets the property value private.
 *
 * @param id property ID.
 * @param property_value property value that must to be setted.
 * @param size property value size.
 *
 * @return error code.
 */
int pdb_property_set_private(pdb_property_e id, u8_t *property_value, size_t size);


#endif
```

## include/pdb_callbacks.h
```c
/**!
 * @file nb_property_system_callbacks.template.h
 * @author Rodrigo Peixoto (rodrigopex)
 * @brief this file was generated by the nodebee tool.
 *
 * DO NOT EDIT THIS FILE!
 *
 */

#ifndef PDB_CALLBACKS_H_
#define PDB_CALLBACKS_H_

#include "pdb.h"
#include "pdb_callbacks.def"

#endif
```

## include/pdb_observers.h
```c
/**
 * @file   pdb_observers.h
 * @author Lucas Peixoto <lucaspeixotoac@gmail.com>
 * 
 * @brief  
 * 
 * 
 */

#ifndef PDB_OBSERVERS_H_
#define PDB_OBSERVERS_H_

#include "pdb.h"

#ifdef PDB_OBSERVER_CREATE
#undef PDB_OBSERVER_CREATE
#endif

#define PDB_OBSERVER_CREATE(_nm, _sz) \
    extern struct k_msgq _nm##_event_queue;

#include "pdb_observers.def"
#undef PDB_OBSERVER_CREATE

#define PDB_OBSERVER_THREAD_CREATE(_nm, _sz, _prior, _cb);              \
    void _cb(pdb_event_t *event);                                       \
    int _nm##_module_thread(void) {                                     \
        pdb_event_t event = {0};                                        \
        while(1) {                                                      \
            if (!k_msgq_get(&_nm##_event_queue, &event, K_SECONDS(10))) { \
                _cb(&event);                                            \
            }                                                           \
        }                                                               \
    }                                                                   \
    K_THREAD_DEFINE(_nm##_module_thread_id, _sz, _nm##_module_thread, NULL, NULL, NULL, _prior, 0, K_NO_WAIT); 


#endif
```

## include/pdb_old.h
```c
/*!
 * @file
 * @brief This is the abstraction information relative to NB hardware
 *
 */

#ifndef PDB_H_
#define PDB_H_

#include <stddef.h>
#include <zephyr.h>
#include <zephyr/types.h>

#define PDB_THREAD_SIZE 1024
#define PDB_THREAD_PRIORITY -2


#define PDB_VALUE_REF(x) (u8_t *) (&x), sizeof(x)
#define PDB_CHECK_VAL(_p, _e, _err, _format, ...) \
    if (_p != _e) {                               \
        printk(_format, ##__VA_ARGS__);           \
        return _err;                              \
    }

#define PDB_CHECK(_p, _err, _format, ...) \
    if (_p) {                             \
        printk(_format, ##__VA_ARGS__);   \
        return _err;                      \
    }


/* Defining PDB_PROPERTY_CREATE for enum generating */
/* #define PDB_PROPERTY_CREATE(_name, _bytes, _validate, _get, _set, _in_flash, _observers, _id,
 * ...) \ */
/*     PDB_##_name##_PROPERTY, */

typedef enum { PDB_PROPERTY_COUNT } pdb_property_e;

typedef struct {
    k_tid_t source_thread;
    pdb_property_e id;
} pdb_event_t;

typedef void (*pdb_callback_f)(pdb_property_e id);

struct pdb_property {
    /* #TODO: Adicionar owners da property */
    const char *name;
    u8_t *data;
    int (*validate)(u8_t *data, size_t size);
    int (*get)(pdb_property_e id, u8_t *property_value, size_t size);
    int (*pre_set)(pdb_property_e id);
    int (*set)(pdb_property_e id, u8_t *property_value, size_t size);
    int (*pos_set)(pdb_property_e id);
    u8_t size;
    u8_t in_flash;
    u8_t changed;
    u8_t observers;
    struct k_sem *sem;
    k_tid_t *publishers_id;
    pdb_callback_f *subscribers_cb;
    pdb_property_e id;
};
typedef struct pdb_property pdb_property_t;

/**
 * Returns the property size.
 *
 * @param id property ID.
 * @param error variable to handle possible errors.
 *
 * @return property size.
 */
size_t pdb_property_size(pdb_property_e id, int *error);

/* TODO: Add doxygen comments about pdb_property_name */
const char *pdb_property_name(pdb_property_e id);

/**
 * Gets the property value.
 *
 * @param id property ID.
 * @param property_value handle the property value.
 * @param size property value size.
 *
 * @return error code.
 */
int pdb_property_get(pdb_property_e id, u8_t *property_value, size_t size);

/**
 * Gets the property value private.
 *
 * @param id property ID.
 * @param property_value handle the property value.
 * @param size property value size.
 *
 * @return error code.
 */
int pdb_property_get_private(pdb_property_e id, u8_t *property_value, size_t size);

/**
 * Sets the property value.
 *
 * @param id property ID.
 * @param property_value property value that must to be setted.
 * @param size property value size.
 *
 * @return error code.
 */
int pdb_property_set(pdb_property_e id, u8_t *property_value, size_t size);


/**
 * Sets the property value private.
 *
 * @param id property ID.
 * @param property_value property value that must to be setted.
 * @param size property value size.
 *
 * @return error code.
 */
int pdb_property_set_private(pdb_property_e id, u8_t *property_value, size_t size);


#endif
```

## include/pdb_unit_tests.h
```c
#ifndef PDB_UNIT_TESTES_H_
#define PDB_UNIT_TESTES_H_
#include "autoconf.h"
#ifdef CONFIG_ZTEST

#include <ztest.h>

void test_properties_name(void);
void test_properties_set(void);
void test_properties_get(void);
void test_properties_size(void);
void test_properties_validate(void);


#endif
#endif
```

## include/pdb_validators.h
```c
/**!
 * @file nb_property_system_validators.template.h
 * @author Rodrigo Peixoto (rodrigopex)
 * @brief this file was generated by the nodebee tool.
 *
 * DO NOT EDIT THIS FILE!
 *
 */

#ifndef PDB_VALIDATORS_H_
#define PDB_VALIDATORS_H_

#include "pdb.h"
#include "pdb_validators.def"

int pdb_validator_different_of_zero(u8_t *data, size_t size);

#endif
```

## src/pdb.c
```c
#include "pdb.h"

#include <fs/nvs.h>
#include <string.h>
#include <zephyr.h>

/* #TODO: Remover código legado da estratégia dos includes */
#include "devicetree_fixups.h"
#include "pdb_callbacks.h"
#include "pdb_observers.h"
#include "pdb_validators.h"

int pdb_thread(void);

#define NVS_SECTOR_SIZE DT_FLASH_ERASE_BLOCK_SIZE  // 4096
#define NVS_SECTOR_COUNT 4
#define NVS_STORAGE_OFFSET DT_FLASH_AREA_STORAGE_OFFSET

static struct nvs_fs pdb_fs = {
    .sector_size  = NVS_SECTOR_SIZE,
    .sector_count = NVS_SECTOR_COUNT,
    .offset       = NVS_STORAGE_OFFSET,
};

K_SEM_DEFINE(pdb_property_sema, 1, 1);

K_THREAD_DEFINE(pdb_thread_id, PDB_THREAD_SIZE, pdb_thread, NULL, NULL, NULL, PDB_THREAD_PRIORITY,
                0, K_NO_WAIT);


/* #define PDB_PROPERTIES_INITIAL_VALUE(_name, _size, ...) \ */
/*     u8_t _name##_initial_value[_size] = {__VA_ARGS__}; */

/* #include "pdb_properties_initial_value.def" */


/* Defining PDB_PROPERTY_CREATE for properties generating */
/* #define PDB_PROPERTY_CREATE(_name, _bytes, _validate, _get, _set, _in_flash, _observers, _id,
 * ...) \ */
/*     {.name      = (const char *) #_name, \ */
/*      .validate  = _validate, \ */
/*      .get       = _get, \ */
/*      .set       = _set, \ */
/*      .size      = sizeof(u8_t) * _bytes, \ */
/*      .in_flash  = _in_flash, \ */
/*      .changed   = 0, \ */
/*      .observers = _observers, \ */
/*      .id        = PDB_##_name##_PROPERTY}, */

static pdb_property_t __pdb_properties[PDB_PROPERTY_COUNT] = {
    /* #include "pdb_properties.def" */
};

static pdb_property_t *pdb_property_get_ref(pdb_property_e id)
{
    if (id < PDB_PROPERTY_COUNT) {
        return &__pdb_properties[id];
    } else {
        return NULL;
    }
}

size_t pdb_property_size(pdb_property_e id, int *error)
{
    size_t size       = 0;
    pdb_property_t *p = pdb_property_get_ref(id);
    if (p) {
        size = (size_t) p->size;
    } else {
        if (error) {
            *error = -EINVAL;
        }
    }
    return size;
}

int pdb_property_get(pdb_property_e id, u8_t *property_value, size_t size)
{
    int error                = 0;
    pdb_property_t *property = pdb_property_get_ref(id);
    if (property && property->get) {
        error = property->get(id, property_value, size);
        if (error) {
            printk("Current property get: %d, error code: %d\n", id, error);
        }
    } else {
        printk("The property #%d does not have a get implementation.\n", id);
    }
    return error;
}

int pdb_property_get_private(pdb_property_e id, u8_t *property_value, size_t size)
{
    int ret = 0;
    if (id < PDB_PROPERTY_COUNT) {
        pdb_property_t *current_property = &__pdb_properties[id];
        if (current_property->size == size) {
            if (k_sem_take(&pdb_property_sema, K_MSEC(200))) {
                printk("Could not get the property. Property is busy\n");
                ret = -EBUSY;
            } else {
                memcpy(property_value, current_property->data, current_property->size);
                k_sem_give(&pdb_property_sema);
            }
        } else {
            ret = -EINVAL;
        }
    } else {
        ret = -ENODATA;
    }
    return ret;
}

int pdb_property_set(pdb_property_e id, u8_t *property_value, size_t size)
{
    /* #TODO: Adicionar pre-set e pos-set */
    int error                = 0;
    int valid                = 1;
    pdb_property_t *property = pdb_property_get_ref(id);

    PDB_ASSERT_VAL(property, NULL, -ENODEV, "The property %d was not found!\n", id);
    PDB_ASSERT_VAL(property->set, NULL, -EPERM, "The property %d is read only!\n", id);
    if (property->validate) {
        valid = property->validate(property_value, size);
    }
    PDB_ASSERT(valid, -EINVAL, "The value doesn't satisfy valid function of property %d!\n", id);
    PDB_ASSERT(property->pre_set(), -EINVAL, "Error on pre_set function of property %d!\n", id);
    error = property->set(id, property_value, size);
    if (error) {
        printk("Current property set: %d, error code: %d!\n", id, error);
    }
    PDB_ASSERT(property->pos_set(), -EINVAL, "Error on pre_set function of property %d!\n", id);
    return error;
}

int pdb_property_set_private(pdb_property_e id, u8_t *property_value, size_t size)
{
    int ret = 0;
    if (id < PDB_PROPERTY_COUNT) {
        pdb_property_t *current_property = &__pdb_properties[id];
        if (current_property->size == size) {
            if (k_sem_take(&pdb_property_sema, K_MSEC(200))) {
                printk("Could not set the property. Property is busy\n");
                ret = -EBUSY;
            } else {
                if (memcmp(current_property->data, property_value, size)) {
                    memcpy(current_property->data, property_value, current_property->size);
                    if (current_property->changed < 255) {
                        current_property->changed++;
                    }
                    k_sem_give(&pdb_property_sema);
                } else {
                    k_sem_give(&pdb_property_sema);
                }
            }
        } else {
            ret = -EINVAL;
        }
    } else {
        ret = -ENODATA;
    }
    return ret;
}

static void __pdb_recover_data_from_flash(void)
{
    int rc = 0;
    printk("Start...\n");
    if (k_sem_take(&pdb_property_sema, K_SECONDS(5)) != 0) {
        printk("Could not set the property. Property is busy\n");
    } else {
        for (u16_t id = 0; id < PDB_PROPERTY_COUNT; ++id) {
            if (__pdb_properties[id].in_flash) {
                rc = nvs_read(&pdb_fs, id, __pdb_properties[id].data, __pdb_properties[id].size);
                if (rc > 0) { /* item was found, show it */
                    printk("Id: %d, value:", id);
                    for (size_t i = 0; i < __pdb_properties[id].size; i++) {
                        printk(" %02X", __pdb_properties[id].data[i]);
                    }
                    printk("|");
                    for (size_t i = 0; i < __pdb_properties[id].size; i++) {
                        if (32 <= __pdb_properties[id].data[i]
                            && __pdb_properties[id].data[i] <= 126) {
                            printk("%c", __pdb_properties[id].data[i]);
                        } else {
                            printk(".");
                        }
                    }
                    printk("\n");
                } else { /* item was not found, add it */
                    printk("No values found for property #%d\n", id);
                }
            }
        }
        k_sem_give(&pdb_property_sema);
    }
}

static void __pdb_persist_data_on_flash(void)
{
    int bytes_written = 0;
    for (u16_t id = 0; id < PDB_PROPERTY_COUNT; ++id) {
        if (__pdb_properties[id].in_flash) {
            if (__pdb_properties[id].changed) {
                // printk("Store changes for property: %d", id);
                bytes_written =
                    nvs_write(&pdb_fs, id, __pdb_properties[id].data, __pdb_properties[id].size);
                if (bytes_written > 0) { /* item was found and updated*/
                    __pdb_properties[id].changed = 0;
                    printk("Property #%d value updated on the flash\n", id);
                } else if (bytes_written == 0) {
                    // printk("Property #%d value is already on the flash.", id);
                } else { /* item was not found, add it */
                    printk("Property #%d could not be stored\n", id);
                }
            }
        } else {
            __pdb_properties[id].changed = 0;
        }
    }
}

/* #define PDB_PROPERTIES_INITIAL_VALUE(_name, _size, ...) \ */
/*     __pdb_properties[PDB_##_name##_PROPERTY].data = _name##_initial_value; */

/* #define PDB_PROPERTY_CREATE(_name, _bytes, _validate, _get, _set, _in_flash, _observers, _id,
 * ...) \ */
/* struct k_msgq *_name##_event_queues[]           = {__VA_ARGS__, NULL};                         \
 */
/* __pdb_properties[PDB_##_name##_PROPERTY].queues = (struct k_msgq **) _name##_event_queues; */

int pdb_thread(void)
{
    /* #include "pdb_properties.def" */
    /* #include "pdb_properties_initial_value.def" */
    /* #TODO: Alterar o funcionamento da thread do pdb */
    int error = nvs_init(&pdb_fs, DT_FLASH_DEV_NAME);
    if (error) {
        printk("Flash Init failed\n");
    } else {
        printk("NVS started...[OK]\n");
    }
    __pdb_recover_data_from_flash();

    while (1) {
        k_sleep(K_SECONDS(10));
        __pdb_persist_data_on_flash();
    }
    return 0;
}

const char *pdb_property_name(pdb_property_e id)
{
    pdb_property_t *p = pdb_property_get_ref(id);

    if (p) {
        return p->name;
    }

    return (const char *) p;
}
```

## src/pdb_callbacks.c
```c
/**!
 * @file nb_property_system_callbacks.template.c
 * @author Rodrigo Peixoto (rodrigopex)
 * @brief this file was generated by the nodebee tool.
 *
 * DO NOT EDIT THIS FILE!
 *
 */
```

## src/pdb_observers.c
```c
/**
 * @file   pdb_observers.c
 * @author Lucas Peixoto <lucaspeixotoac@gmail.com>
 * 
 * 
 */

#include <zephyr.h>
#include "pdb.h"
#include "pdb_observers.h"

#ifdef PDB_OBSERVER_CREATE
#undef PDB_OBSERVER_CREATE
#endif

#define PDB_OBSERVER_CREATE(_nm, _sz) \
    K_MSGQ_DEFINE(_nm##_event_queue, sizeof(pdb_event_t), _sz, 1);

#include "pdb_observers.def"
#undef PDB_OBSERVER_CREATE

#include "pdb_observers_thread.def"
```

## src/pdb_unit_tests.c
```c
#include "autoconf.h"
#ifdef CONFIG_ZTEST

#include <string.h>

#include "pdb.h"
#include "pdb_unit_tests.h"

int set_plus_1(pdb_property_e id, u8_t *property_value, size_t size)
{
    u8_t new_value = *property_value + 1;
    pdb_property_set_private(id, &new_value, size);

    return 0;
}

int get_plus_1(pdb_property_e id, u8_t *property_value, size_t size)
{
    pdb_property_get_private(id, property_value, size);
    *property_value = *property_value + 1;

    return 0;
}

void test_properties_name(void)
{
    zassert_true(!strcmp("FIRMWARE_VERSION", pdb_property_name(PDB_FIRMWARE_VERSION_PROPERTY)),
                 "Firmware version property name is wrong: %s",
                 pdb_property_name(PDB_FIRMWARE_VERSION_PROPERTY));

    zassert_true(!strcmp("PERSISTENT_VAL", pdb_property_name(PDB_PERSISTENT_VAL_PROPERTY)),
                 "PERSISTENT_VAL property name is wrong: %s",
                 pdb_property_name(PDB_PERSISTENT_VAL_PROPERTY));

    zassert_true(!strcmp("ECHO_HAL", pdb_property_name(PDB_ECHO_HAL_PROPERTY)),
                 "ECHO_HAL property name is wrong: %s", pdb_property_name(PDB_ECHO_HAL_PROPERTY));

    zassert_true(!strcmp("SET_GET", pdb_property_name(PDB_SET_GET_PROPERTY)),
                 "SET_GET property name is wrong: %s", pdb_property_name(PDB_SET_GET_PROPERTY));
}

void test_properties_set(void)
{
    u32_t new_firmware_version = 0xABCDED0F;
    u8_t value                 = 0;
    int error                  = 0;

    /* Testing if set functions was correct assigned */
    error = pdb_property_set(PDB_FIRMWARE_VERSION_PROPERTY, PDB_VALUE_REF(new_firmware_version));
    zassert_equal(error, -ENODEV,
                  "FIRMWARE_VERSION property was defined with a non null set pointer!");

    error = pdb_property_set(PDB_PERSISTENT_VAL_PROPERTY, PDB_VALUE_REF(value));
    zassert_equal(error, -EINVAL,
                  "PERSISTENT_VAL property is allowing set a value zero to property: %d!", error);
    value = 0xF1;
    error = pdb_property_set(PDB_PERSISTENT_VAL_PROPERTY, PDB_VALUE_REF(value));
    zassert_equal(error, 0, "PERSISTENT_VAL property is not setting a valid value(%X), error: %d",
                  value, error);

    error = pdb_property_set(PDB_SET_GET_PROPERTY, PDB_VALUE_REF(value));
    zassert_equal(error, 0, "SET_GET property is not setting a valid value(%X), error: %d", value,
                  error);
    error = pdb_property_set(PDB_ECHO_HAL_PROPERTY, PDB_VALUE_REF(value));
    zassert_equal(error, 0, "ECHO_HAL property is not setting a valid value(%X), error: %d", value,
                  error);
}

void test_properties_get(void)
{
    u8_t firmware_version[4] = {0};
    u8_t value               = 0;
    int error                = 0;

    error =
        pdb_property_get(PDB_FIRMWARE_VERSION_PROPERTY, firmware_version, sizeof(firmware_version));
    zassert_false(error,
                  "PDB is not allowing get value from property FIRMWARE_VERSION, error code: %d!",
                  error);
    zassert_equal(0xF1, firmware_version[0],
                  "FIRMWARE_VERSION property must to has 0xF1 as the value of the first byte, "
                  "value found %02X!",
                  firmware_version[0]);
    zassert_equal(0xF2, firmware_version[1],
                  "FIRMWARE_VERSION property must to has 0xF2 as the value of the second byte, "
                  "value found %02X!",
                  firmware_version[1]);
    zassert_equal(0xF3, firmware_version[2],
                  "FIRMWARE_VERSION property must to has 0xF3 as the value of the third byte, "
                  "value found %02X!",
                  firmware_version[2]);
    zassert_equal(0xF4, firmware_version[3],
                  "FIRMWARE_VERSION property must to has 0xF4 as the value of the fourth byte, "
                  "value found %02X!",
                  firmware_version[3]);

    error = pdb_property_get(PDB_PERSISTENT_VAL_PROPERTY, PDB_VALUE_REF(value));
    zassert_equal(0xF1, value,
                  "PERSISTENT_VAL property must to has 0xF1 as the value, value found %02X!",
                  value);

    error = pdb_property_get(PDB_SET_GET_PROPERTY, PDB_VALUE_REF(value));
    zassert_equal(0xF3, value, "SET_GET property must to has 0xF3 as the value, value found %02X!",
                  value);
}

void test_properties_size(void)
{
    zassert_equal(4, pdb_property_size(PDB_FIRMWARE_VERSION_PROPERTY, NULL),
                  "FIRMWARE_VERSION size is different of 4: %d",
                  pdb_property_size(PDB_FIRMWARE_VERSION_PROPERTY, NULL));
    zassert_equal(1, pdb_property_size(PDB_PERSISTENT_VAL_PROPERTY, NULL),
                  "PERSISTENT_VAL size is different of 1: %d",
                  pdb_property_size(PDB_PERSISTENT_VAL_PROPERTY, NULL));
    zassert_equal(1, pdb_property_size(PDB_ECHO_HAL_PROPERTY, NULL),
                  "ECHO_HAL size is different of 1: %d",
                  pdb_property_size(PDB_ECHO_HAL_PROPERTY, NULL));
    zassert_equal(1, pdb_property_size(PDB_SET_GET_PROPERTY, NULL),
                  "SET_GET size is different of 1: %d",
                  pdb_property_size(PDB_SET_GET_PROPERTY, NULL));
}

void test_set(void)
{
    u8_t value = 0x44;

    /* Testing pdb_property_set correctness  */
    zassert_true(pdb_property_set(PDB_PROPERTY_COUNT, PDB_VALUE_REF(value)),
                 "PDB is allowing set a value to an invalid property!");

    zassert_true(pdb_property_set(PDB_ECHO_HAL_PROPERTY, &value, sizeof(value) + 1),
                 "PDB is allowing set a value with wrong size!");
}


#endif
```

## src/pdb_validators.c
```c
/**!
 * @file nb_property_system_validators.template.c
 * @author Rodrigo Peixoto (rodrigopex)
 * @brief this file was generated by the nodebee tool.
 *
 * DO NOT EDIT THIS FILE!
 *
 */

#include "pdb_validators.h"

int pdb_validator_different_of_zero(u8_t *data, size_t size) {
    int f = 1;
    for(int i = 0 ; i < size ; ++i) {
        f = f && (data[i] != 0);
    }

    return f;
}
```

## src/test_main.c
```c
/**
 * @file   test_main.c
 * @author Lucas Peixoto <lucaspeixotoac@gmail.com>
 *
 *
 *
 */
```
