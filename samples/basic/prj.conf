## CMakeLists.txt
```
cmake_minimum_required(VERSION 3.13.1)

include(zeta.cmake NO_POLICY_SCOPE)

find_package(Zephyr HINTS $ENV{ZEPHYR_BASE})
project(Zeta)


# Generate version file
set(CMAKE_EXPORT_COMPILE_COMMANDS ON)

# Add header directories
list(APPEND HEADERS
    "${PROJECT_BINARY_DIR}/zephyr/include/generated"
    "${PROJECT_SOURCE_DIR}/include"
    )

list(APPEND SOURCES
    "${PROJECT_SOURCE_DIR}/src/main.c"
    )

target_include_directories(app PRIVATE ${HEADERS})
target_sources(app PRIVATE ${SOURCES})
```

## prj.conf
```kconfig
CONFIG_LOG=y
CONFIG_LOG_MODE_MINIMAL=y

CONFIG_ZETA_LOG_LEVEL_DBG=y
CONFIG_ZETA_FORWARDER=y

CONFIG_SERIAL=y
CONFIG_UART_INTERRUPT_DRIVEN=y
```

## prj_nrf52840dk_nrf52840.conf
```kconfig
CONFIG_LOG=y
CONFIG_LOG_PRINTK=y
CONFIG_LOG_IMMEDIATE=y
CONFIG_LOG_MAX_LEVEL=4
CONFIG_LOG_DEFAULT_LEVEL=4
CONFIG_TEST_LOGGING_DEFAULTS=n
CONFIG_ZETA_FORWARDER=y
CONFIG_SERIAL=y

CONFIG_GPIO=y
CONFIG_THREAD_MONITOR=y
CONFIG_THREAD_ANALYZER=y
CONFIG_THREAD_ANALYZER_USE_PRINTK=y
CONFIG_THREAD_ANALYZER_AUTO=y
CONFIG_THREAD_ANALYZER_AUTO_INTERVAL=5
CONFIG_THREAD_NAME=y
CONFIG_UART_INTERRUPT_DRIVEN=y
```

## prj_nrf52840dongle_nrf52840.conf
```kconfig
CONFIG_GPIO=y
CONFIG_THREAD_MONITOR=y
CONFIG_USB=y
CONFIG_USB_DEVICE_STACK=y
CONFIG_USB_DEVICE_PRODUCT="Zephyr USB console sample"
CONFIG_USB_UART_CONSOLE=y

CONFIG_UART_INTERRUPT_DRIVEN=y
CONFIG_UART_LINE_CTRL=y
CONFIG_UART_CONSOLE_ON_DEV_NAME="CDC_ACM_0"
```

## src/main.c
```c
/*
 * Copyright (c) 2012-2014 Wind River Systems, Inc.
 *
 * SPDX-License-Identifier: Apache-2.0
 */

#include <zephyr.h>

#include "autoconf.h"
#include "zeta.h"

K_SEM_DEFINE(zt_core_pend_evt, 0, 1);
K_SEM_DEFINE(zt_app_pend_evt, 0, 1);

zt_channel_e zt_core_evt_id;
zt_channel_e zt_app_evt_id;

void HAL_task(void)
{
    zt_data_t *data = ZT_DATA_U8(1);
    while (1) {
        zt_chan_pub(ZT_SENSOR_VAL_CHANNEL, data);
        k_sleep(K_SECONDS(3));
        data->u8.value = (data->u8.value + 1 <= 15) ? data->u8.value + 1 : 1;
    }
}

void CORE_task(void)
{
    zt_data_t *data = ZT_DATA_U8(1);
    u8_t power      = 2;

    while (1) {
        zt_data_t *result = ZT_DATA_U16(1);
        k_sem_take(&zt_core_pend_evt, K_FOREVER);
        switch (zt_core_evt_id) {
        case ZT_SENSOR_VAL_CHANNEL:
            zt_chan_read(zt_core_evt_id, data);
            printk("[CORE_service_callback] Getting data value %02X\n", data->u8.value);
            for (u8_t i = 1; i <= data->u8.value; ++i) {
                result->u16.value = result->u16.value * power;
            }
            zt_chan_pub(ZT_POWER_VAL_CHANNEL, result);
            break;
        default:
            printk("[CORE_service_callback] receiving an unexpected id channel\n");
            break;
        }
    }
}

void APP_task(void)
{
    zt_data_t *fv = ZT_DATA_BYTES(4, 0);
    printk("Hello APP task!\n");
    zt_chan_read(ZT_FIRMWARE_VERSION_CHANNEL, fv);
    printk("Firmware version 0x%02X%02X%02X%02X\n", fv->bytes.value[0],
           fv->bytes.value[1], fv->bytes.value[2], fv->bytes.value[3]);
    zt_data_t *data = ZT_DATA_U16(0);
    while (1) {
        k_sem_take(&zt_app_pend_evt, K_FOREVER);
        switch (zt_app_evt_id) {
        case ZT_POWER_VAL_CHANNEL:
            zt_chan_read(zt_app_evt_id, data);
            printk("[APP_service_callback] Power val is: %04X\n", data->u16.value);
            break;
        default:
            printk("[APP_service_callback] receiving an unexpected id channel\n");
        }
    }
}

void CORE_service_callback(zt_channel_e id)
{
    zt_core_evt_id = id;
    k_sem_give(&zt_core_pend_evt);
}

void HAL_service_callback(zt_channel_e id)
{
}

void APP_service_callback(zt_channel_e id)
{
    zt_app_evt_id = id;
    k_sem_give(&zt_app_pend_evt);
}

void main(void)
{
    printk("******** ZETA BASIC SAMPLE! *******\n");
}

ZT_SERVICE_INIT(CORE, CORE_task, CORE_service_callback);
ZT_SERVICE_INIT(HAL, HAL_task, HAL_service_callback);
ZT_SERVICE_INIT(APP, APP_task, APP_service_callback);
```
