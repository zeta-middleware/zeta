## CMakeLists.txt
```
# SPDX-License-Identifier: Apache-2.0
cmake_minimum_required(VERSION 3.13.1)

include(zeta.cmake NO_POLICY_SCOPE)
find_package(Zephyr HINTS $ENV{ZEPHYR_BASE})
project(light_control)

set(CMAKE_EXPORT_COMPILE_COMMANDS ON)

list(APPEND HEADERS "${CMAKE_CURRENT_LIST_DIR}/zeta/include/")

list(APPEND SOURCES "${PROJECT_SOURCE_DIR}/src/peripheral.c"
     "${PROJECT_SOURCE_DIR}/src/core.c" "${PROJECT_SOURCE_DIR}/src/net.c"
     "${PROJECT_SOURCE_DIR}/src/main.c")

message("Headers: ${HEADERS}")
message("Soucers: ${SOURCES}")
include_directories(${HEADERS})
target_sources(app PRIVATE ${SOURCES})
```

## prj.conf
```kconfig
CONFIG_LOG=y
CONFIG_LOG_MINIMAL=y

CONFIG_ZETA_LOG_LEVEL_DBG=y
CONFIG_ZETA_FORWARDER=y

CONFIG_SERIAL=y
CONFIG_UART_INTERRUPT_DRIVEN=y
```

## prj_native_posix.conf
```kconfig
CONFIG_LOG=y
CONFIG_LOG_PRINTK=y
CONFIG_LOG_IMMEDIATE=y
CONFIG_LOG_MAX_LEVEL=4
CONFIG_LOG_DEFAULT_LEVEL=4
CONFIG_TEST_LOGGING_DEFAULTS=n
CONFIG_ZETA_FORWARDER=y
CONFIG_SERIAL=y
CONFIG_UART_NATIVE_POSIX=y
CONFIG_NATIVE_UART_0_ON_OWN_PTY=y
CONFIG_NATIVE_UART_0_ON_STDINOUT=n
```

## src/main.c
```c
/**
 * @file main.c
 * @brief Main thread is just an execution countdown in this sample.
 * @author Rodrigo Peixoto
 * @version 0.1
 * @date 2020-04-28
 */

#include <sys/printk.h>
#include <zephyr.h>
#include "zeta.h"

extern void posix_exit(int error);

/**
 * @brief The main thread stops the execution after 120 seconds of operation.
 */
void main(void)
{
    printk("Started the main thread running on a %s board.\n", CONFIG_BOARD);
}
```

## src/core.c
```c
/**
 * @file core.c
 * @brief The CORE service is used to control the load status based on the light level
 * channel value.
 * @author Rodrigo Peixoto
 * @version 0.1
 * @date 2020-04-28
 */

#include <zephyr.h>
#include "zeta.h"

K_SEM_DEFINE(core_event_sem, 0, 1);


/**
 * @brief This is the function used by Zeta to tell the CORE that one(s) of the channels
 * which it is subscribed has changed. This callback will be called passing the channel's
 * id in it.
 *
 * @param id
 */
void CORE_service_callback(zt_channel_e id)
{
    k_sem_give(&core_event_sem);
}

struct version {
    uint16_t build;
    uint8_t minor;
    uint8_t major;
};


/**
 * @brief This is the task loop responsible to run the CORE thread functionality.
 */
void CORE_task()
{
    printk("Hello CORE!\n");
    zt_data_t *version = ZT_DATA_BYTES(4, 0);
    zt_chan_read(ZT_FIRMWARE_VERSION_CHANNEL, version);
    struct version *v = (struct version *) version->bytes.value;
    printk("Firmware version: %d.%d.%d\n", v->major, v->minor, v->build);
    zt_data_t *load        = ZT_DATA_U8(0);
    zt_data_t *light_level = ZT_DATA_U8(0);
    zt_data_t *mc          = ZT_DATA_U16(0);
    while (1) {
        k_sem_take(&core_event_sem, K_FOREVER);
        zt_chan_read(ZT_MANUAL_LOAD_CONTROL_CHANNEL, mc);
        if (mc->bytes.value[0] == 1) {
            load->u8.value = mc->bytes.value[1];
            printk("[CORE]: Manual load control -> Load = %s\n",
                   load->u8.value ? "on" : "off");
        } else {
            zt_chan_read(ZT_LIGHT_LEVEL_CHANNEL, light_level);
            load->u8.value = light_level->u8.value < 96;
            printk("[CORE]: Light level is %03u -> Load = %s\n", light_level->u8.value,
                   load->u8.value ? "on" : "off");
        }
        zt_chan_pub(ZT_LOAD_CHANNEL, load);
    }
}

ZT_SERVICE_DECLARE(CORE, CORE_task, CORE_service_callback);
```

## src/net.c
```c
/**
 * @file net.c
 * @brief The NET service is used to send commands to CORE and make a fake schedule of
 * sending data to the cloud.
 * @author Rodrigo Peixoto
 * @version 0.1
 * @date 2020-04-28
 */
#include <zephyr.h>
#include "zeta.h"

/**
 * @brief This is the function used by Zeta to tell the NET that one(s) of the channels
 * which it is subscribed has changed. This callback will be called passing the channel's
 * id in it.
 *
 * @param id
 */
void NET_service_callback(zt_channel_e id)
{
    switch (id) {
    case ZT_LOAD_CHANNEL: {
        printk("[NET]: Schedule to send status to the cloud\n");
    } break;
    default:
        printk("[NET]: Undesired event %d\n", id);
    }
}

/**
 * @brief This is the task loop responsible to run the NET thread functionality.
 */
void NET_task()
{
    zt_data_t *manual_load_control = ZT_DATA_BYTES(2, 0x00, 0x01);
    printk("Hello NET\n");
    while (1) {
        manual_load_control->bytes.value[0] = 1;
        printk("on\n");
        zt_chan_pub(ZT_MANUAL_LOAD_CONTROL_CHANNEL, manual_load_control);
        k_sleep(K_SECONDS(5));
        printk("off\n");
        manual_load_control->bytes.value[0] = 0;
        zt_chan_pub(ZT_MANUAL_LOAD_CONTROL_CHANNEL, manual_load_control);
        k_sleep(K_SECONDS(10));
    }
}

ZT_SERVICE_DECLARE(NET, NET_task, NET_service_callback);
```

## src/peripheral.c
```c
/**
 * @file peripheral.c
 * @brief The PERIPHERAL service is used to abstract hardware handling
 * @author Rodrigo Peixoto
 * @version 0.1
 * @date 2020-04-28
 */
#include <zephyr.h>
#include "zeta.h"
u8_t light_level_sensor_fetch()
{
    return k_uptime_get();
}

/**
 * @brief This is the function used by Zeta to tell the PERIPHERAL that one(s) of the
 * channels which it is subscribed has changed. This callback will be called passing the
 * channel's id in it.
 *
 * @param id
 */
void PERIPHERAL_service_callback(zt_channel_e id)
{
    switch (id) {
    case ZT_LOAD_CHANNEL: {
        zt_data_t* load = ZT_DATA_U8(0);
        zt_chan_read(ZT_LOAD_CHANNEL, load);
        printk("[PERIPHERAL]: The load is turning %s\n", load->u8.value ? "on" : "off");
    } break;
    default:
        printk("Unknown id");
    }
}

/**
 * @brief This is the task loop responsible to run the PERIPHERAL thread functionality.
 */
void PERIPHERAL_task()
{
    printk("Hello PERIPHERAL!\n");
    zt_data_t* light_level = ZT_DATA_U8(0);
    while (1) {
        light_level->u8.value = light_level_sensor_fetch();
        zt_chan_pub(ZT_LIGHT_LEVEL_CHANNEL, light_level);
        k_sleep(K_SECONDS(2));
    }
}

ZT_SERVICE_INIT(PERIPHERAL, PERIPHERAL_task, PERIPHERAL_service_callback);
```
