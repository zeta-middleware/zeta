## CMakeLists.txt
```
# SPDX-License-Identifier: Apache-2.0

cmake_minimum_required(VERSION 3.13.1)
include(zeta.cmake NO_POLICY_SCOPE)
find_package(Zephyr HINTS $ENV{ZEPHYR_BASE})
project(console)

set(CMAKE_EXPORT_COMPILE_COMMANDS ON)

include_directories(${HEADERS})
target_sources(app PRIVATE ${SOURCES})
```

## Kconfig
```
# Copyright (c) 2019 Nordic Semiconductor ASA
# SPDX-License-Identifier: Apache-2.0

# if BOARD_NRF52840DONGLE_NRF52840
config USB_DEVICE_PID
	default USB_PID_CONSOLE_SAMPLE
# endif
source "Kconfig.zephyr"
```

## prj.conf
```kconfig
CONFIG_LOG=y
CONFIG_ZETA_LOG_LEVEL_DBG=y
```

## prj_nrf52840_pca10059.conf
```kconfig
CONFIG_LOG=n
CONFIG_ZETA_LOG_LEVEL_DBG=n

CONFIG_GPIO=y

CONFIG_USB=y
CONFIG_USB_DEVICE_STACK=y
CONFIG_USB_DEVICE_PRODUCT="Zephyr USB console sample"
CONFIG_USB_UART_CONSOLE=y

CONFIG_UART_INTERRUPT_DRIVEN=y
CONFIG_UART_LINE_CTRL=y
CONFIG_UART_CONSOLE_ON_DEV_NAME="CDC_ACM_0"

CONFIG_USB_UART_DTR_WAIT=y
```

## src/ping.c
```c
#include <logging/log.h>
#include <zephyr.h>
#include <zeta.h>
#include "kernel.h"
#include "sys/printk.h"
#include "zephyr/types.h"

LOG_MODULE_DECLARE(zeta, CONFIG_ZETA_LOG_LEVEL);

K_SEM_DEFINE(PING_callback_sem, 0, 1);


uint32_t end_cycles   = 0;
uint32_t total_cycles = 0;
uint32_t start_cycles = 0;
/**
 * @brief This is the function used by Zeta to tell the PING that one(s) of the
 * channels which it is subscribed has changed. This callback will be called passing the
 * channel's id in it.
 *
 * @param id
 */
void PING_service_callback(zt_channel_e id)
{
    k_sem_give(&PING_callback_sem);
}

/**
 * @brief This is the task loop responsible to run the PING thread
 * functionality.
 */
void PING_task()
{
    LOG_DBG("PING Service has started...[OK]");
    uint8_t current_channel     = ZT_C01_CHANNEL;
    uint8_t number_of_callbacks = 1;
    zt_data_t *ping_data        = ZT_DATA_U32(0xF0F0F0F0);
    total_cycles                = 0;
    start_cycles                = k_cycle_get_32();
    zt_chan_pub(current_channel, ping_data);
    int count = 1000;
    while (1) {
        k_sem_take(&PING_callback_sem, K_FOREVER);
        /* printk("\rCount = %04d", count); */
        if (count == 0) {
            count               = 1001;
            number_of_callbacks = current_channel - ZT_PONG_CHANNEL;
            printk("[%u bytes]Total cycles = %u\n", number_of_callbacks, total_cycles);
            printk("[%u bytes]Total in us = %llu\n", number_of_callbacks,
                   k_cyc_to_us_floor64(total_cycles));
            printk("[%u bytes]Mean in us = %llu\n", number_of_callbacks,
                   k_cyc_to_us_floor64(total_cycles) / (number_of_callbacks * 1000));
            total_cycles = 0;
            if (current_channel < ZT_C10_CHANNEL) {
                ++current_channel;
            } else {
                printk("END of test\n");
                while (1) {
                    k_sleep(K_SECONDS(1));
                }
            }
        }
        --count;
        /*  Start another interaction */
        start_cycles = k_cycle_get_32();
        zt_chan_pub(current_channel, ping_data);
    }
}

ZT_SERVICE_DECLARE(PING, PING_task, PING_service_callback);
```

## src/pong.c
```c
#include <logging/log.h>
#include <zephyr.h>
#include <zeta.h>
#include "sys/printk.h"

LOG_MODULE_DECLARE(zeta, CONFIG_ZETA_LOG_LEVEL);

K_SEM_DEFINE(PONG_callback_sem, 0, 1);

extern u32_t total_cycles;
extern u32_t start_cycles;

/**
 * @brief This is the function used by Zeta to tell the PONG that one(s) of the
 * channels which it is subscribed has changed. This callback will be called passing the
 * channel's id in it.
 *
 * @param id
 */
void PONG_service_callback(zt_channel_e id)
{
    total_cycles += (k_cycle_get_32() - start_cycles);
    k_sem_give(&PONG_callback_sem);
}

/**
 * @brief This is the task loop responsible to run the PONG thread
 * functionality.
 */
void PONG_task()
{
    LOG_DBG("PONG Service has started...[OK]");
    while (1) {
        k_sem_take(&PONG_callback_sem, K_FOREVER);
        zt_chan_pub(ZT_PONG_CHANNEL, ZT_DATA_U32(0x0F0F0F0F));
    }
}

ZT_SERVICE_INIT(PONG, PONG_task, PONG_service_callback);
```

## src/s02.c
```c
#include <logging/log.h>
#include <zephyr.h>
#include <zeta.h>
#include "kernel.h"

LOG_MODULE_DECLARE(zeta, CONFIG_ZETA_LOG_LEVEL);

K_SEM_DEFINE(S02_callback_sem, 0, 1);

extern uint32_t total_cycles;
extern uint32_t start_cycles;
/**
 * @brief This is the function used by Zeta to tell the S02 that one(s) of the
 * channels which it is subscribed has changed. This callback will be called passing the
 * channel's id in it.
 *
 * @param id
 */
void S02_service_callback(zt_channel_e id)
{
    total_cycles += (k_cycle_get_32() - start_cycles);
    k_sem_give(&S02_callback_sem);
}

/**
 * @brief This is the task loop responsible to run the S02 thread
 * functionality.
 */
void S02_task()
{
    LOG_DBG("S02 Service has started...[OK]");
    while (1) {
        k_sem_take(&S02_callback_sem, K_FOREVER);
    }
}

ZT_SERVICE_DECLARE(S02, S02_task, S02_service_callback);
```

## src/s03.c
```c
#include <logging/log.h>
#include <zephyr.h>
#include <zeta.h>

LOG_MODULE_DECLARE(zeta, CONFIG_ZETA_LOG_LEVEL);

K_SEM_DEFINE(S03_callback_sem, 0, 1);

extern uint32_t total_cycles;
extern uint32_t start_cycles;

/**
 * @brief This is the function used by Zeta to tell the S03 that one(s) of the
 * channels which it is subscribed has changed. This callback will be called passing the
 * channel's id in it.
 *
 * @param id
 */
void S03_service_callback(zt_channel_e id)
{
    total_cycles += (k_cycle_get_32() - start_cycles);
    k_sem_give(&S03_callback_sem);
}

/**
 * @brief This is the task loop responsible to run the S03 thread
 * functionality.
 */
void S03_task()
{
    LOG_DBG("S03 Service has started...[OK]");
    while (1) {
        k_sem_take(&S03_callback_sem, K_FOREVER);
    }
}

ZT_SERVICE_DECLARE(S03, S03_task, S03_service_callback);
```

## src/s04.c
```c
#include <logging/log.h>
#include <zephyr.h>
#include <zeta.h>

LOG_MODULE_DECLARE(zeta, CONFIG_ZETA_LOG_LEVEL);

K_SEM_DEFINE(S04_callback_sem, 0, 1);

extern u32_t total_cycles;
extern u32_t start_cycles;

/**
 * @brief This is the function used by Zeta to tell the S04 that one(s) of the
 * channels which it is subscribed has changed. This callback will be called passing the
 * channel's id in it.
 *
 * @param id
 */
void S04_service_callback(zt_channel_e id)
{
    total_cycles += (k_cycle_get_32() - start_cycles);
    k_sem_give(&S04_callback_sem);
}

/**
 * @brief This is the task loop responsible to run the S04 thread
 * functionality.
 */
void S04_task()
{
    LOG_DBG("S04 Service has started...[OK]");
    while (1) {
        k_sem_take(&S04_callback_sem, K_FOREVER);
    }
}

ZT_SERVICE_INIT(S04, S04_task, S04_service_callback);
```

## src/s05.c
```c
#include <logging/log.h>
#include <zephyr.h>
#include <zeta.h>

LOG_MODULE_DECLARE(zeta, CONFIG_ZETA_LOG_LEVEL);

K_SEM_DEFINE(S05_callback_sem, 0, 1);

extern uint32_t total_cycles;
extern uint32_t start_cycles;

/**
 * @brief This is the function used by Zeta to tell the S05 that one(s) of the
 * channels which it is subscribed has changed. This callback will be called passing the
 * channel's id in it.
 *
 * @param id
 */
void S05_service_callback(zt_channel_e id)
{
    total_cycles += (k_cycle_get_32() - start_cycles);
    k_sem_give(&S05_callback_sem);
}

/**
 * @brief This is the task loop responsible to run the S05 thread
 * functionality.
 */
void S05_task()
{
    LOG_DBG("S05 Service has started...[OK]");
    while (1) {
        k_sem_take(&S05_callback_sem, K_FOREVER);
    }
}

ZT_SERVICE_DECLARE(S05, S05_task, S05_service_callback);
```

## src/s06.c
```c
#include <logging/log.h>
#include <zephyr.h>
#include <zeta.h>

LOG_MODULE_DECLARE(zeta, CONFIG_ZETA_LOG_LEVEL);

K_SEM_DEFINE(S06_callback_sem, 0, 1);

extern uint32_t total_cycles;
extern uint32_t start_cycles;

/**
 * @brief This is the function used by Zeta to tell the S06 that one(s) of the
 * channels which it is subscribed has changed. This callback will be called passing the
 * channel's id in it.
 *
 * @param id
 */
void S06_service_callback(zt_channel_e id)
{
    total_cycles += (k_cycle_get_32() - start_cycles);
    k_sem_give(&S06_callback_sem);
}

/**
 * @brief This is the task loop responsible to run the S06 thread
 * functionality.
 */
void S06_task()
{
    LOG_DBG("S06 Service has started...[OK]");
    while (1) {
        k_sem_take(&S06_callback_sem, K_FOREVER);
    }
}

ZT_SERVICE_DECLARE(S06, S06_task, S06_service_callback);
```

## src/s07.c
```c
#include <logging/log.h>
#include <zephyr.h>
#include <zeta.h>

LOG_MODULE_DECLARE(zeta, CONFIG_ZETA_LOG_LEVEL);

K_SEM_DEFINE(S07_callback_sem, 0, 1);

extern uint32_t total_cycles;
extern uint32_t start_cycles;

/**
 * @brief This is the function used by Zeta to tell the S07 that one(s) of the
 * channels which it is subscribed has changed. This callback will be called passing the
 * channel's id in it.
 *
 * @param id
 */
void S07_service_callback(zt_channel_e id)
{
    total_cycles += (k_cycle_get_32() - start_cycles);
    k_sem_give(&S07_callback_sem);
}

/**
 * @brief This is the task loop responsible to run the S07 thread
 * functionality.
 */
void S07_task()
{
    LOG_DBG("S07 Service has started...[OK]");
    while (1) {
        k_sem_take(&S07_callback_sem, K_FOREVER);
    }
}

ZT_SERVICE_DECLARE(S07, S07_task, S07_service_callback);
```

## src/s08.c
```c
#include <logging/log.h>
#include <zephyr.h>
#include <zeta.h>

LOG_MODULE_DECLARE(zeta, CONFIG_ZETA_LOG_LEVEL);

K_SEM_DEFINE(S08_callback_sem, 0, 1);

extern u32_t total_cycles;
extern u32_t start_cycles;

/**
 * @brief This is the function used by Zeta to tell the S08 that one(s) of the
 * channels which it is subscribed has changed. This callback will be called passing the
 * channel's id in it.
 *
 * @param id
 */
void S08_service_callback(zt_channel_e id)
{
    total_cycles += (k_cycle_get_32() - start_cycles);
    k_sem_give(&S08_callback_sem);
}

/**
 * @brief This is the task loop responsible to run the S08 thread
 * functionality.
 */
void S08_task()
{
    LOG_DBG("S08 Service has started...[OK]");
    while (1) {
        k_sem_take(&S08_callback_sem, K_FOREVER);
    }
}

ZT_SERVICE_INIT(S08, S08_task, S08_service_callback);
```

## src/s09.c
```c
#include <logging/log.h>
#include <zephyr.h>
#include <zeta.h>

LOG_MODULE_DECLARE(zeta, CONFIG_ZETA_LOG_LEVEL);

K_SEM_DEFINE(S09_callback_sem, 0, 1);

extern uint32_t total_cycles;
extern uint32_t start_cycles;

/**
 * @brief This is the function used by Zeta to tell the S09 that one(s) of the
 * channels which it is subscribed has changed. This callback will be called passing the
 * channel's id in it.
 *
 * @param id
 */
void S09_service_callback(zt_channel_e id)
{
    total_cycles += (k_cycle_get_32() - start_cycles);
    k_sem_give(&S09_callback_sem);
}

/**
 * @brief This is the task loop responsible to run the S09 thread
 * functionality.
 */
void S09_task()
{
    LOG_DBG("S09 Service has started...[OK]");
    while (1) {
        k_sem_take(&S09_callback_sem, K_FOREVER);
    }
}

ZT_SERVICE_DECLARE(S09, S09_task, S09_service_callback);
```

## src/s10.c
```c
#include <logging/log.h>
#include <zephyr.h>
#include <zeta.h>

LOG_MODULE_DECLARE(zeta, CONFIG_ZETA_LOG_LEVEL);

K_SEM_DEFINE(S10_callback_sem, 0, 1);

extern uint32_t total_cycles;
extern uint32_t start_cycles;

/**
 * @brief This is the function used by Zeta to tell the S10 that one(s) of the
 * channels which it is subscribed has changed. This callback will be called passing the
 * channel's id in it.
 *
 * @param id
 */
void S10_service_callback(zt_channel_e id)
{
    total_cycles += (k_cycle_get_32() - start_cycles);
    k_sem_give(&S10_callback_sem);
}

/**
 * @brief This is the task loop responsible to run the S10 thread
 * functionality.
 */
void S10_task()
{
    LOG_DBG("S10 Service has started...[OK]");
    while (1) {
        k_sem_take(&S10_callback_sem, K_FOREVER);
    }
}

ZT_SERVICE_DECLARE(S10, S10_task, S10_service_callback);
```
