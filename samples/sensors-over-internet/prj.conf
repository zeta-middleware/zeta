## CMakeLists.txt
```
cmake_minimum_required(VERSION 3.13.1)

include(zeta.cmake NO_POLICY_SCOPE)
find_package(Zephyr HINTS $ENV{ZEPHYR_BASE})
project(project_name)

set(CMAKE_EXPORT_COMPILE_COMMANDS ON)

include_directories(${HEADERS})
target_sources(app PRIVATE ${SOURCES})
```

## prj.conf
```kconfig
CONFIG_LOG=y
CONFIG_ZETA=y
CONFIG_ZETA_LOG_LEVEL_DBG=y

CONFIG_TRACING=y
CONFIG_TRACING_CPU_STATS=y
CONFIG_TRACING_CPU_STATS_LOG=n

CONFIG_TEST_RANDOM_GENERATOR=y
CONFIG_TIMER_RANDOM_GENERATOR=y
```

## prj_native_posix.conf
```kconfig
CONFIG_LOG=y
CONFIG_LOG_PRINTK=y
CONFIG_LOG_IMMEDIATE=y
CONFIG_LOG_MAX_LEVEL=4
CONFIG_LOG_DEFAULT_LEVEL=4
CONFIG_ZETA_FORWARDER=y
CONFIG_SERIAL=y

CONFIG_UART_NATIVE_POSIX=y
CONFIG_NATIVE_UART_0_ON_OWN_PTY=y
CONFIG_NATIVE_UART_0_ON_STDINOUT=n

CONFIG_TRACING=y
CONFIG_TRACING_CPU_STATS=y
CONFIG_TRACING_CPU_STATS_LOG=n
```

## prj_nrf52840_pca10059.conf
```kconfig
CONFIG_LOG=y
CONFIG_ZETA_LOG_LEVEL_DBG=y

# CONFIG_GPIO=y
# CONFIG_USB=y
# CONFIG_USB_DEVICE_STACK=y
# CONFIG_USB_DEVICE_VID=0x2FE9

# CONFIG_TRACING=y
# CONFIG_TRACING_CTF=y
# CONFIG_TRACING_ASYNC=y
# CONFIG_TRACING_BACKEND_USB=y
# CONFIG_TRACING_HANDLE_HOST_CMD=y
# CONFIG_TRACING_BUFFER_SIZE=4096

CONFIG_GPIO=y
CONFIG_USB=y
CONFIG_USB_DEVICE_STACK=y
CONFIG_USB_DEVICE_PRODUCT="Zephyr USB console sample"
CONFIG_USB_UART_CONSOLE=y

CONFIG_UART_INTERRUPT_DRIVEN=y
CONFIG_UART_LINE_CTRL=y
CONFIG_UART_CONSOLE_ON_DEV_NAME="CDC_ACM_0"

CONFIG_USB_UART_DTR_WAIT=y

CONFIG_TRACING=y
CONFIG_TRACING_CPU_STATS=y
CONFIG_TRACING_CPU_STATS_LOG=n

CONFIG_TEST_RANDOM_GENERATOR=y
CONFIG_TIMER_RANDOM_GENERATOR=y
```

## src/board.c
```c
#include <logging/log.h>
#include <zephyr.h>
#include <zeta.h>

LOG_MODULE_DECLARE(zeta, CONFIG_ZETA_LOG_LEVEL);

static uint8_t get_sensor_a(void)
{
    static uint8_t data_a = 20;

    data_a++;
    if (data_a > 40) {
        data_a = 20;
    }

    return data_a;
}

static uint8_t get_sensor_b(void)
{
    static uint8_t data_b = 90;

    data_b--;
    if (data_b < 40) {
        data_b = 90;
    }

    return data_b;
}

static uint32_t get_sensor_c(void)
{
    static uint32_t data_c = 101325;

    data_c += 27;
    if (data_c > 102000) {
        data_c = 101325;
    }

    return data_c;
}

void BOARD_task()
{
    LOG_DBG("BOARD Service has started...[OK]");

    zt_data_t *data_a = ZT_DATA_U8(0);
    zt_data_t *data_b = ZT_DATA_U8(0);
    zt_data_t *data_c = ZT_DATA_U32(0);

    while (1) {
        data_a->u8.value = get_sensor_a();
        zt_chan_pub(ZT_SENSOR_A_CHANNEL, data_a);

        data_b->u8.value = get_sensor_b();
        zt_chan_pub(ZT_SENSOR_B_CHANNEL, data_b);

        data_c->u32.value = get_sensor_c();
        zt_chan_pub(ZT_SENSOR_C_CHANNEL, data_c);
        k_sleep(K_SECONDS(3));
    }
}

ZT_SERVICE_DECLARE(BOARD, BOARD_task, NULL);
```

## src/core.c
```c
#include <logging/log.h>
#include <zephyr.h>
#include <zeta.h>

LOG_MODULE_DECLARE(zeta, CONFIG_ZETA_LOG_LEVEL);

K_MSGQ_DEFINE(CORE_callback_msgq, sizeof(uint8_t), 30, 4);

#define MAX_RING_SIZE 11

static uint8_t ring_data_a[MAX_RING_SIZE];
static uint8_t ring_data_b[MAX_RING_SIZE];
static uint32_t ring_data_c[MAX_RING_SIZE];
static uint8_t id_a;
static uint8_t id_b;
static uint8_t id_c;

static uint16_t sensor_a_mean(void)
{
    uint16_t sum = 0;
    int i        = 0;
    for (i = 0; i < MAX_RING_SIZE && ring_data_a[i] != 0; i++) {
        sum += ring_data_a[i];
    }

    LOG_DBG("A Mean -> i: %d, sum: %d, mean: %d", i, sum, sum / i);
    return sum / i;
}

static uint16_t sensor_b_mean(void)
{
    uint16_t sum = 0;
    int i        = 0;
    for (i = 0; i < MAX_RING_SIZE && ring_data_b[i] != 0; i++) {
        sum += ring_data_b[i];
    }

    LOG_DBG("B Mean -> i: %d, sum: %d, mean: %d", i, sum, sum / i);
    return sum / i;
}

static uint32_t sensor_c_mean(void)
{
    uint32_t sum = 0;
    int i        = 0;
    for (i = 0; i < MAX_RING_SIZE && ring_data_c[i] != 0; i++) {
        sum += ring_data_c[i];
    }

    LOG_DBG("C Mean -> i: %d, sum: %d, mean: %d", i, sum, sum / i);
    return sum / i;
}

static void core_handle_channel_callback(uint8_t channel_id)
{
    zt_data_t *data_u8      = ZT_DATA_U8(0);
    zt_data_t *data_u32     = ZT_DATA_U32(0);
    zt_data_t *net_response = ZT_DATA_BYTES(5, 0);
    switch (channel_id) {
    case ZT_SENSOR_A_CHANNEL:
        zt_chan_read(channel_id, data_u8);
        ring_data_a[id_a] = data_u8->u8.value;
        id_a              = (id_a + 1) % MAX_RING_SIZE;
        LOG_DBG("Data received from sensor A: %d", data_u8->u8.value);
        break;
    case ZT_SENSOR_B_CHANNEL:
        zt_chan_read(channel_id, data_u8);
        ring_data_b[id_b] = data_u8->u8.value;
        id_b              = (id_b + 1) % MAX_RING_SIZE;
        LOG_DBG("Data received from sensor B: %d", data_u8->u8.value);
        break;
    case ZT_SENSOR_C_CHANNEL:
        zt_chan_read(channel_id, data_u32);
        ring_data_c[id_c] = data_u32->u32.value;
        id_c              = (id_c + 1) % MAX_RING_SIZE;
        LOG_DBG("Data received from sensor C: %d", data_u32->u32.value);
        break;
    case ZT_NET_REQUEST_CHANNEL:
        zt_chan_read(channel_id, data_u8);
        net_response->bytes.value[0] = data_u8->u8.value;
        if (data_u8->u8.value == 0xA0) {  // Requesting last A data
            net_response->bytes.value[1] =
                ring_data_a[(id_a == 0) ? MAX_RING_SIZE : id_a - 1];
        } else if (data_u8->u8.value == 0xA1) {  // Requesting last B data
            net_response->bytes.value[1] =
                ring_data_b[(id_b == 0) ? MAX_RING_SIZE : id_b - 1];
        } else if (data_u8->u8.value == 0xA2) {  // Requesting last C data
            memcpy(net_response->bytes.value + 1,
                   &ring_data_c[(id_c == 0) ? MAX_RING_SIZE : id_c - 1],
                   sizeof(uint32_t));
        } else if (data_u8->u8.value == 0xA3) {  // Requesting A mean
            uint16_t a_mean = sensor_a_mean();
            memcpy(net_response->bytes.value + 1, &a_mean, sizeof(uint16_t));
        } else if (data_u8->u8.value == 0xA4) {  // Requesting B mean
            uint16_t b_mean = sensor_b_mean();
            memcpy(net_response->bytes.value + 1, &b_mean, sizeof(uint16_t));
        } else if (data_u8->u8.value == 0xA5) {  // Requesting C mean
            uint32_t c_mean = sensor_c_mean();
            memcpy(net_response->bytes.value + 1, &c_mean, sizeof(uint32_t));
        } else {
            LOG_DBG("Net request sent is invalid!");
        }
        LOG_DBG("Net request received with ID: %02X", data_u8->u8.value);
        zt_chan_pub(ZT_NET_RESPONSE_CHANNEL, net_response);
        break;
    default:
        break;
    }
}

/**
 * @brief This is the function used by Zeta to tell the CORE that one(s) of the
 * channels which it is subscribed has changed. This callback will be called passing
 * the channel's id in it.
 *
 * @param id
 */
void CORE_service_callback(zt_channel_e id)
{
    LOG_DBG("Calling CORE Callback...");
    k_msgq_put(&CORE_callback_msgq, &id, K_NO_WAIT);
}

/**
 * @brief This is the task loop responsible to run the CORE thread
 * functionality.
 */
void CORE_task()
{
    LOG_DBG("CORE Service has started...[OK]");
    uint8_t channel_id = 0;
    while (1) {
        k_msgq_get(&CORE_callback_msgq, &channel_id, K_FOREVER);
        core_handle_channel_callback(channel_id);
    }
}

ZT_SERVICE_DECLARE(CORE, CORE_task, CORE_service_callback);
```

## src/net.c
```c
#include <logging/log.h>
#include <stdlib.h>
#include <zephyr.h>
#include <zeta.h>

LOG_MODULE_DECLARE(zeta, CONFIG_ZETA_LOG_LEVEL);

K_MSGQ_DEFINE(NET_callback_msgq, sizeof(uint8_t), 30, 4);

uint8_t generate_random_number(uint8_t lower, uint8_t upper)
{
    static int counter = 0;
    counter++;
    return (counter % (upper - lower + 1)) + lower;
}

static void handle_net_requests(void)
{
    uint8_t num               = generate_random_number(1, 36);
    zt_data_t *packet_request = ZT_DATA_U8(0);
    if (num <= 6) {
        packet_request->u8.value = 0xA0;
    } else if (num <= 12) {
        packet_request->u8.value = 0xA1;
    } else if (num <= 18) {
        packet_request->u8.value = 0xA2;
    } else if (num <= 24) {
        packet_request->u8.value = 0xA3;
    } else if (num <= 30) {
        packet_request->u8.value = 0xA4;
    } else if (num <= 36) {
        packet_request->u8.value = 0xA5;
    }

    LOG_DBG("Getting a virtual packet request from net with id: %02X",
            packet_request->u8.value);
    LOG_DBG("Sending a net packet request to NET_REQUEST channel...");
    zt_chan_pub(ZT_NET_REQUEST_CHANNEL, packet_request);
}

static void net_handle_channel_callback(uint8_t channel_id)
{
    zt_data_t *net_response = ZT_DATA_BYTES(5, 0);
    switch (channel_id) {
    case ZT_NET_RESPONSE_CHANNEL:
        zt_chan_read(channel_id, net_response);
        LOG_DBG("Net response received: %02X", net_response->bytes.value[0]);
        if (net_response->bytes.value[0] == 0xA0) {  // Requesting last A data
            LOG_DBG("Last sensor A data saved: %d", net_response->bytes.value[1]);
        } else if (net_response->bytes.value[0] == 0xA1) {  // Requesting last B data
            LOG_DBG("Last sensor B data saved: %d", net_response->bytes.value[1]);
        } else if (net_response->bytes.value[0] == 0xA2) {  // Requesting last C data
            uint32_t c_value = 0;
            memcpy(&c_value, net_response->bytes.value + 1, sizeof(uint32_t));
            LOG_DBG("Last sensor C data saved: %d", c_value);
        } else if (net_response->bytes.value[0] == 0xA3) {  // Requesting A mean
            uint16_t a_mean = 0;
            memcpy(&a_mean, net_response->bytes.value + 1, sizeof(uint16_t));
            LOG_DBG("Current A mean: %d", a_mean);
        } else if (net_response->bytes.value[0] == 0xA4) {  // Requesting B mean
            uint16_t b_mean = 0;
            memcpy(&b_mean, net_response->bytes.value + 1, sizeof(uint16_t));
            LOG_DBG("Current B mean: %d", b_mean);
        } else if (net_response->bytes.value[0] == 0xA5) {  // Requesting C mean
            uint32_t c_mean = 0;
            memcpy(&c_mean, net_response->bytes.value + 1, sizeof(uint32_t));
            LOG_DBG("Current C mean: %d", c_mean);
        } else {
            LOG_DBG("Net response sent is invalid!");
        }
        break;
    default:
        break;
    }
}

/**
 * @brief This is the function used by Zeta to tell the NET that one(s) of the
 * channels which it is subscribed has changed. This callback will be called passing the
 * channel's id in it.
 *
 * @param id
 */
void NET_service_callback(zt_channel_e id)
{
    LOG_DBG("Calling NET Callback...");
    k_msgq_put(&NET_callback_msgq, &id, K_NO_WAIT);
}

/**
 * @brief This is the task loop responsible to run the NET thread
 * functionality.
 */
void NET_task()
{
    LOG_DBG("NET Service has started...[OK]");
    uint8_t channel_id = 0;
    while (1) {
        k_msgq_get(&NET_callback_msgq, &channel_id, K_NO_WAIT);
        net_handle_channel_callback(channel_id);
        handle_net_requests();
        k_sleep(K_SECONDS(10));
#if defined(CONFIG_TRACING)
        uint32_t per = cpu_stats_non_idle_and_sched_get_percent();
        LOG_WRN("CPU usage: %u%%\n", per);
        cpu_stats_reset_counters();
#endif
    }
}

ZT_SERVICE_DECLARE(NET, NET_task, NET_service_callback);
```
