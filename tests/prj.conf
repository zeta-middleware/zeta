## CMakeLists.txt
```
cmake_minimum_required(VERSION 3.13.1)

set(BOARD_ROOT ${CMAKE_SOURCE_DIR})

include(zeta.cmake NO_POLICY_SCOPE)

find_package(Zephyr HINTS $ENV{ZEPHYR_BASE})
project(Zeta)

# Generate version file
set(CMAKE_EXPORT_COMPILE_COMMANDS ON)

# Add header directories
list(APPEND HEADERS
    "${PROJECT_BINARY_DIR}/zephyr/include/generated"
    "${PROJECT_SOURCE_DIR}/include"
    )

list(APPEND SOURCES
    "${PROJECT_SOURCE_DIR}/src/test_main.c"
    "${PROJECT_SOURCE_DIR}/src/test_functions.c"
    )

target_include_directories(app PRIVATE ${HEADERS})
target_sources(app PRIVATE ${SOURCES})
```

## prj.conf
```kconfig
# LOG
CONFIG_LOG=y
CONFIG_LOG_MAX_LEVEL=4
CONFIG_LOG_DEFAULT_LEVEL=4
CONFIG_TEST_LOGGING_DEFAULTS=n

# Test
CONFIG_ZTEST=y
```

## include/zeta_unit_tests.h
```c
#ifndef ZETA_UNIT_TESTES_H_
#define ZETA_UNIT_TESTES_H_
#ifdef CONFIG_ZTEST
#include <ztest.h>

#include "autoconf.h"

extern struct k_sem ztest_sem;

#endif
#endif
```

## src/test_functions.c
```c
#include <ztest.h>

#include "zephyr/types.h"
#include "zeta.h"
#include "zeta_unit_tests.h"
#include "ztest_assert.h"

K_SEM_DEFINE(ztest_sem, 0, 1);
K_SEM_DEFINE(zt_core_pend_evt, 0, 1);
K_SEM_DEFINE(zt_app_pend_evt, 0, 1);

u8_t sensor_a_hit = 0;
u8_t sensor_b_hit = 0;
u8_t sensor_c_hit = 0;
zt_channel_e zt_core_evt_id;

void PONG_task(void)
{
    int error      = 0;
    int count      = 0;
    u16_t expected = 0;
    while (1) {
        zt_data_t *data = ZT_DATA_U16(0);
        k_sem_take(&zt_core_pend_evt, K_FOREVER);
        if (zt_core_evt_id == ZT_CH02_CHANNEL) {
            error = zt_chan_read(ZT_CH02_CHANNEL, data);
            if (count == 0) {
                expected = 0xbbaa;
                count++;
            } else {
                expected = 0x01;
            }
            zassert_equal(data->u16.value, expected,
                          "CH02 channel was not publish correctly %x!\n",
                          data->u16.value);
        }
    }
}

void PONG_service_callback(zt_channel_e id)
{
    if (id == ZT_CH05_CHANNEL) {
        sensor_c_hit++;
    }
    zt_core_evt_id = id;
    k_sem_give(&zt_core_pend_evt);
}


void PING_task(void)
{
    zt_data_t *data = ZT_DATA_U8(0);
    int error       = 0;

    /* Testing invalid calls to CH01 channel */
    error = zt_chan_read(ZT_CHANNEL_COUNT, data);
    zassert_equal(error, -ENODATA,
                  "Get function is allowing read data from a non existent channel!\n");
    zt_data_t *g0 = ZT_DATA_U8(0);
    error         = zt_chan_read(ZT_CHANNEL_COUNT, g0);
    zassert_equal(error, -ENODATA,
                  "Get function is allowing read data from a non existent channel!\n");

    error = zt_chan_read(ZT_CH01_CHANNEL, ZT_DATA_BYTES(40, 0));
    zassert_equal(error, -EINVAL,
                  "Get function either isn't checking data size or is checking wrong, "
                  "error code: %d!\n",
                  error);

    zt_data_t *g1 = ZT_DATA_U64(0);
    error         = zt_chan_read(ZT_CH01_CHANNEL, g1);
    zassert_equal(error, -EINVAL,
                  "Get function either isn't checking data size or is checking wrong, "
                  "error code: %d!\n",
                  error);

    error = zt_chan_read(ZT_CH01_CHANNEL, NULL);
    zassert_equal(error, -EFAULT,
                  "Get function is allowing the call with data parameter NULL!\n");

    /* Testing invalid publish calls to CH02 channel*/
    error = zt_chan_pub(ZT_CHANNEL_COUNT, data);
    zassert_equal(error, -ENODATA,
                  "Set function is allowing publish data from a non existent channel!\n");
    zt_data_t *d0 = ZT_DATA_U8(0);
    error         = zt_chan_pub(ZT_CHANNEL_COUNT, d0);
    zassert_equal(error, -ENODATA,
                  "Set function is allowing publish data from a non existent channel!\n");
    error = zt_chan_pub(ZT_CH02_CHANNEL, NULL);
    zassert_equal(error, -EFAULT,
                  "Set function is allowing the call with data paramemter NULL!\n");
    error = zt_chan_pub(ZT_CH02_CHANNEL, data);
    zassert_equal(error, -EINVAL,
                  "Set function either isn't checking data size or is checking wrong, "
                  "error code: %d!\n",
                  error);
    error = zt_chan_pub(ZT_CH01_CHANNEL, ZT_DATA_U8(0));
    zassert_equal(error, -EPERM,
                  "Publish function is not checking the readonly filed before publish, "
                  "error code: %d!\n",
                  error);
    zt_data_t *d1 = ZT_DATA_U64(0);
    error         = zt_chan_pub(ZT_CH02_CHANNEL, d1);
    zassert_equal(error, -EINVAL,
                  "Set function either isn't checking data size or is checking wrong, "
                  "error code: %d!\n",
                  error);

    /* Testing valid publish call to CH02 channel */
    error = zt_chan_pub(ZT_CH02_CHANNEL, ZT_DATA_U16(0xbbaa));
    zassert_equal(error, 0, "Error executing a valid publish call!\n");
    /* zassert_equal(running_urgent_routine, 1, */
    /*               "CH02 pos publish function didn't run properly!\n"); */
    zt_data_t *d3 = ZT_DATA_U16(0);
    zt_chan_read(ZT_CH02_CHANNEL, d3);
    zassert_equal(d3->u16.value, 0xbbaa, "CH02 (%x) isn't the expected value 0xbbaa",
                  d3->u16.value);
    d3->u16.value = 1;
    error         = zt_chan_pub(ZT_CH02_CHANNEL, d3);
    zassert_equal(error, 0, "Error executing a valid publish call!\n");
    zt_chan_read(ZT_CH02_CHANNEL, d3);
    zassert_equal(d3->u16.value, 1, "CH02 (%d) isn't the expected value 1",
                  d3->u16.value);

    /* Testing react_on field on CH03 creation */
    zt_data_t *ch03 = ZT_DATA_U64(0);
    zt_chan_read(ZT_CH03_CHANNEL, ch03);
    zassert_equal(ch03->u64.value, 0, "Error old value is wrong: %x", ch03->u64.value);
    ch03->u64.value = 0xff;
    error           = zt_chan_pub(ZT_CH03_CHANNEL, ch03);
    zassert_equal(error, 0, "Error executing a valid publish call!\n");
    zt_chan_read(ZT_CH03_CHANNEL, ch03);
    zassert_equal(ch03->u64.value, 0xff, "Error old value is wrong: %x", ch03->u64.value);
    zassert_equal(sensor_a_hit, 1,
                  "PONG2 callback was not called with a valid call(value different from "
                  "existent) %d\n",
                  sensor_a_hit);
    error = zt_chan_pub(ZT_CH03_CHANNEL, ch03);
    zassert_equal(error, 0, "Error executing a valid publish call!\n");
    zassert_equal(sensor_a_hit, 1,
                  "PONG2 callback was called on a publish procedure without changes on "
                  "channel value!\n");

    /* Testing react_on field on CH04 creation  */
    error = zt_chan_pub(ZT_CH04_CHANNEL, ZT_DATA_BYTES(128, 1));
    zassert_equal(error, 0, "Error executing a valid publish call!\n");
    zassert_equal(sensor_b_hit, 1, "PONG2 callback was not called with a valid call\n");
    zt_chan_pub(ZT_CH04_CHANNEL, ZT_DATA_BYTES(128, 1));
    zassert_equal(sensor_b_hit, 2,
                  "PONG2 callback was not called on a channel that react on update!\n");

    /* Testing calling multiple callbacks on CH05 */
    error = zt_chan_pub(ZT_CH05_CHANNEL, ZT_DATA_BYTES(255, 0));
    zassert_equal(error, 0, "Error executing a valid publish call! %d\n", error);
    zassert_equal(sensor_c_hit, 2,
                  "PONG or PONG2 callback was not called with a valid call\n");
    zt_chan_pub(ZT_CH05_CHANNEL, ZT_DATA_BYTES(255, 1));
    zassert_equal(
        sensor_c_hit, 4,
        "PONG or PONG2 callback was not called on a channel that react on update!\n");
    k_sleep(K_MSEC(100));
    k_sem_give(&ztest_sem);
}


void PING_service_callback(zt_channel_e id)
{
}

void PONG2_service_callback(zt_channel_e id)
{
    if (id == ZT_CH03_CHANNEL) {
        sensor_a_hit++;
    } else if (id == ZT_CH04_CHANNEL) {
        sensor_b_hit++;
    } else if (id == ZT_CH05_CHANNEL) {
        sensor_c_hit++;
    }
}

void PONG2_task(void)
{
}

ZT_SERVICE_INIT(PING, PING_task, PING_service_callback);
ZT_SERVICE_INIT(PONG, PONG_task, PONG_service_callback);
ZT_SERVICE_INIT(PONG2, PONG2_task, PONG2_service_callback);
```

## src/test_main.c
```c
#include <string.h>
#include <zephyr.h>
#include <ztest.h>

#include "autoconf.h"
#include "zeta.h"
#include "zeta_unit_tests.h"

void test_data()
{
    zt_data_t *data0 = ZT_DATA_S8(-1);
    zassert_equal(data0->s8.size, sizeof(s8_t),
                  "[%s] zt_data size %d is wrong. It must be 1!\n", __FUNCTION__,
                  data0->s8.size);
    zt_data_t *data1 = ZT_DATA_U8(-1);
    zassert_equal(data1->u8.size, sizeof(u8_t),
                  "[%s] zt_data size %d is wrong. It must be 1!\n", __FUNCTION__,
                  data1->u8.size);
    zt_data_t *data2 = ZT_DATA_S16(-1);
    zassert_equal(data2->s16.size, sizeof(s16_t),
                  "[%s] zt_data size %d is wrong. It must be 2!\n", __FUNCTION__,
                  data2->s16.size);
    zt_data_t *data3 = ZT_DATA_U16(-1);
    zassert_equal(data3->u16.size, sizeof(u16_t),
                  "[%s] zt_data size %d is wrong. It must be 2!\n", __FUNCTION__,
                  data3->u16.size);
    zt_data_t *data4 = ZT_DATA_S32(-1);
    zassert_equal(data4->s32.size, sizeof(s32_t),
                  "[%s] zt_data size %d is wrong. It must be 4!\n", __FUNCTION__,
                  data4->s32.size);
    zt_data_t *data5 = ZT_DATA_U32(-1);
    zassert_equal(data5->u32.size, sizeof(u32_t),
                  "[%s] zt_data size %d is wrong. It must be 4!\n", __FUNCTION__,
                  data5->s32.size);
    zt_data_t *data6 = ZT_DATA_S64(-1);
    zassert_equal(data6->s64.size, sizeof(s64_t),
                  "[%s] zt_data size %d is wrong. It must be 8!\n", __FUNCTION__,
                  data6->s64.size);
    zt_data_t *data7 = ZT_DATA_BYTES(64, 0);
    zassert_equal(data7->bytes.size, 64,
                  "[%s] zt_data size %d is wrong. It must be 64!\n", __FUNCTION__,
                  data7->bytes.size);

    zt_data_t *data8 =
        ZT_DATA_BYTES(16, 0, 1, 2, 3, 4, 5, 6, 7, 8, 9, 0xa, 0xb, 0xc, 0xd, 0xe, 0xf);
    zassert_equal(data8->bytes.size, 16,
                  "[%s] zt_data size %d is wrong. It must be 20!\n", __FUNCTION__,
                  data8->bytes.size);
    for (int i = 0; i < data8->bytes.size; i++) {
        zassert_equal(
            data8->bytes.value[i], i,
            "[%s] at index %d zt_data value is wrong 0x%x. It must be 0xff !\n ",
            __FUNCTION__, i, data8->bytes.value[i]);
    }
    zassert_equal(data8->s8.value, 0x00,
                  "[%s] zt_data value is wrong %02x. It must be 0!\n", __FUNCTION__,
                  data8->s8.value);
    zassert_equal(data8->u8.value, 0x00,
                  "[%s] zt_data value is wrong %02x. It must be 0x00!\n", __FUNCTION__,
                  data8->u8.value);
    zassert_equal(data8->s16.value, 0x0100,
                  "[%s] zt_data value is wrong %04x. It must be -1!\n", __FUNCTION__,
                  data8->s16.value);
    zassert_equal(data8->u16.value, 0x0100,
                  "[%s] zt_data value is wrong %04x. It must be -1!\n", __FUNCTION__,
                  data8->u16.value);
    zassert_equal(data8->s32.value, 0x03020100,
                  "[%s] zt_data value is wrong %08x. It must be -1!\n", __FUNCTION__,
                  data8->s32.value);
    zassert_equal(data8->u32.value, 0x03020100,
                  "[%s] zt_data value is wrong %08x. It must be -1!\n", __FUNCTION__,
                  data8->u32.value);
    zassert_equal(data8->s64.value, 0x0706050403020100,
                  "[%s] zt_data value is wrong %016x. It must be -1!\n", __FUNCTION__,
                  data8->s64.value);
    zassert_equal(data8->u64.value, 0x0706050403020100,
                  "[%s] zt_data value is wrong %016x. It must be -1!\n", __FUNCTION__,
                  data8->u64.value);

    zt_data_t *data = ZT_DATA_U64(-1);
    zassert_equal(data->s8.size, sizeof(u64_t),
                  "[%s] zt_data size %d is wrong. It must be 8!\n", __FUNCTION__,
                  data->s8.size);
    zassert_equal(data->s8.value, -1, "[%s] zt_data value is wrong %d. It must be -1!\n",
                  __FUNCTION__, data->s8.value);
    zassert_equal(data->u8.value, 255, "[%s] zt_data value is wrong %d. It must be -1!\n",
                  __FUNCTION__, data->u8.value);
    zassert_equal(data->s16.value, -1, "[%s] zt_data value is wrong %d. It must be -1!\n",
                  __FUNCTION__, data->s16.value);
    zassert_equal(data->u16.value, 65535,
                  "[%s] zt_data value is wrong %d. It must be -1!\n", __FUNCTION__,
                  data->u16.value);
    zassert_equal(data->s32.value, -1, "[%s] zt_data value is wrong %d. It must be -1!\n",
                  __FUNCTION__, data->s32.value);
    zassert_equal(data->u32.value, 4294967295,
                  "[%s] zt_data value is wrong %d. It must be -1!\n", __FUNCTION__,
                  data->u32.value);
    zassert_equal(data->s64.value, -1, "[%s] zt_data value is wrong %d. It must be -1!\n",
                  __FUNCTION__, data->s64.value);
    zassert_equal(data->u64.value, 18446744073709551615U,
                  "[%s] zt_data value is wrong %llu. It must be -1!\n", __FUNCTION__,
                  data->u64.value);
    for (int i = 0; i < data->bytes.size; i++) {
        zassert_equal(
            data->bytes.value[i], 0xff,
            "[%s] at index %d zt_data value is wrong 0x%x. It must be 0xff !\n ",
            __FUNCTION__, i, data->bytes.value[i]);
    }
}

void test_channels_name(void)
{
    int error        = 0;
    const char *name = NULL;

    /* Checking an invalid call */
    name = zt_channel_name(ZT_CHANNEL_COUNT, &error);
    zassert_equal(error, -EINVAL,
                  "[%s] zt_channel_name is allowing an invalid channel id!\n",
                  __FUNCTION__);
    zassert_equal(
        name, NULL,
        "[%s] zt_channel_name is not returning NULL pointer in an invalid call!\n",
        __FUNCTION__);
    /* Checking FIRMWARE_VERSION call */
    error = 1;
    name  = zt_channel_name(ZT_FIRMWARE_VERSION_CHANNEL, &error);
    zassert_equal(error, 0,
                  "[%s] zt_channel_name is not setting error to 0 in a valid call!\n",
                  __FUNCTION__);
    zassert_true(!strcmp(name, "FIRMWARE_VERSION"),
                 "[%s] channel #%d was created with a wrong name: %s\n", __FUNCTION__,
                 ZT_FIRMWARE_VERSION_CHANNEL, name);

    /* Checking CH01 call */
    error = 1;
    name  = zt_channel_name(ZT_CH01_CHANNEL, &error);
    zassert_equal(error, 0,
                  "[%s] zt_channel_name is not setting error to 0 in a valid call!\n",
                  __FUNCTION__);
    zassert_true(!strcmp(name, "CH01"),
                 "[%s] channel #%d was created with a wrong name: %s\n", __FUNCTION__,
                 ZT_CH01_CHANNEL, name);

    /* Checking CH02 call */
    error = 1;
    name  = zt_channel_name(ZT_CH02_CHANNEL, &error);
    zassert_equal(error, 0,
                  "[%s] zt_channel_name is not setting error to 0 in a valid call!\n",
                  __FUNCTION__);
    zassert_true(!strcmp(name, "CH02"),
                 "[%s] channel #%d was created with a wrong name: %s\n", __FUNCTION__,
                 ZT_CH02_CHANNEL, name);
    /* Checking CH03 call */
    error = 1;
    name  = zt_channel_name(ZT_CH03_CHANNEL, &error);
    zassert_equal(error, 0,
                  "[%s] zt_channel_name is not setting error to 0 in a valid call!\n",
                  __FUNCTION__);
    zassert_true(!strcmp(name, "CH03"),
                 "[%s] channel #%d was created with a wrong name: %s\n", __FUNCTION__,
                 ZT_CH03_CHANNEL, name);
    /* Checking CH04 call */
    error = 1;
    name  = zt_channel_name(ZT_CH04_CHANNEL, &error);
    zassert_equal(error, 0,
                  "[%s] zt_channel_name is not setting error to 0 in a valid call!\n",
                  __FUNCTION__);
    zassert_true(!strcmp(name, "CH04"),
                 "[%s] channel #%d was created with a wrong name: %s\n", __FUNCTION__,
                 ZT_CH04_CHANNEL, name);
}

void test_channels_size(void)
{
    size_t sz = 0;
    int error = 0;

    /* Checking an invalid call */
    sz = zt_channel_size(ZT_CHANNEL_COUNT, &error);
    zassert_equal(error, -EINVAL,
                  "[%s] zt_channel_size is not setting error to -EINVAL!\n",
                  __FUNCTION__);
    zassert_equal(sz, 0, "[%s] zt_channel_size is not returning 0 in an invalid call!\n",
                  __FUNCTION__);

    /* Checking FIRMWARE_VERSION size*/
    sz = zt_channel_size(ZT_FIRMWARE_VERSION_CHANNEL, &error);
    zassert_equal(error, 0,
                  "[%s] zt_channel_size is setting error to %d in a valid call!\n",
                  __FUNCTION__, error);
    zassert_equal(sz, 4, "[%s] zt_channel_size returned a wrong size value: %d\n",
                  __FUNCTION__, sz);

    /* Checking CH01 size*/
    sz = zt_channel_size(ZT_CH01_CHANNEL, &error);
    zassert_equal(error, 0,
                  "[%s] zt_channel_size is setting error to %d in a valid call!\n",
                  __FUNCTION__, error);
    zassert_equal(sz, 1, "[%s] zt_channel_size returned a wrong size value: %d\n",
                  __FUNCTION__, sz);
    /* Checking CH02 size*/
    sz = zt_channel_size(ZT_CH02_CHANNEL, &error);
    zassert_equal(error, 0,
                  "[%s] zt_channel_size is setting error to %d in a valid call!\n",
                  __FUNCTION__, error);
    zassert_equal(sz, 2, "[%s] zt_channel_size returned a wrong size value: %d\n",
                  __FUNCTION__, sz);

    /* Checking CH03 size*/
    sz = zt_channel_size(ZT_CH03_CHANNEL, &error);
    zassert_equal(error, 0,
                  "[%s] zt_channel_size is setting error to %d in a valid call!\n",
                  __FUNCTION__, error);
    zassert_equal(sz, 8, "[%s] zt_channel_size returned a wrong size value: %d\n",
                  __FUNCTION__, sz);
    /* Checking CH04 size*/
    sz = zt_channel_size(ZT_CH04_CHANNEL, &error);
    zassert_equal(error, 0,
                  "[%s] zt_channel_size is setting error to %d in a valid call!\n",
                  __FUNCTION__, error);
    zassert_equal(sz, 128, "[%s] zt_channel_size returned a wrong size value: %d\n",
                  __FUNCTION__, sz);
}

void test_channels_routine(void)
{
    k_sem_take(&ztest_sem, K_FOREVER);
}

void test_main(void)
{
    ztest_test_suite(ZT_CHECK_CHANNELS_GENERATION, ztest_unit_test(test_data),
                     ztest_unit_test(test_channels_name),
                     ztest_unit_test(test_channels_size),
                     ztest_unit_test(test_channels_routine));

    ztest_run_test_suite(ZT_CHECK_CHANNELS_GENERATION);
}
```
